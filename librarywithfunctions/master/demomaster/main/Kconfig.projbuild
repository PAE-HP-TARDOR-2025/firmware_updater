## librarywithfunctions/master/demomaster/main/Kconfig.projbuild
```kconfig
menu "Master Uploader Configuration"

    config MASTER_NODE_ID
        int "CANopen node ID for master"
        default 1
        range 1 127
        help
            The CANopen node ID for this master device.

    config MASTER_TARGET_NODE_ID
        int "Target slave node ID"
        default 10
        range 1 127
        help
            The CANopen node ID of the slave to upload firmware to.

    config MASTER_TWAI_TX_GPIO
        int "TWAI TX GPIO"
        default 5
        help
            GPIO pin for TWAI (CAN) transmit.

    config MASTER_TWAI_RX_GPIO
        int "TWAI RX GPIO"
        default 4
        help
            GPIO pin for TWAI (CAN) receive.

    config MASTER_USE_SPIFFS
        bool "Use SPIFFS for firmware storage"
        default y
        help
            Mount SPIFFS partition for storing firmware binaries.

    config MASTER_SPIFFS_BASE_PATH
        string "SPIFFS mount path"
        default "/spiffs"
        depends on MASTER_USE_SPIFFS
        help
            Base path where SPIFFS is mounted.

    config MASTER_SPIFFS_PARTITION_LABEL
        string "SPIFFS partition label"
        default "storage"
        depends on MASTER_USE_SPIFFS
        help
            Partition label for SPIFFS.

    config MASTER_FIRMWARE_PATH
        string "Firmware file path"
        default "/spiffs/slave_fw.bin"
        help
            Path to the firmware binary to upload.

    config MASTER_MAX_CHUNK_BYTES
        int "Maximum chunk size"
        default 256
        range 64 1024
        help
            Maximum bytes per SDO block transfer chunk.

    config MASTER_UPLOAD_ON_STARTUP
        bool "Upload firmware on startup"
        default y
        help
            Automatically start firmware upload when master boots.

    config MASTER_SKIP_IF_CRC_MATCH
        bool "Skip upload if CRC matches"
        default y
        help
            Query slave's running firmware CRC first and skip upload if it matches.

    config MASTER_FIRMWARE_VERSION
        int "Firmware version to send"
        default 1
        range 1 65535
        help
            Firmware version number (1-65535) to send in metadata.
            Must match the version in the slave firmware being uploaded.

endmenu
```

## librarywithfunctions/slave/demoslave/main/Kconfig.projbuild
```kconfig
menu "Demo Slave Configuration"

    config DEMO_SLAVE_NODE_ID
        int "CANopen Node-ID"
        default 10
        range 1 127
        help
            CANopen node ID for the slave device.

    config DEMO_SLAVE_CAN_BITRATE_KBPS
        int "CAN bitrate (kbps)"
        default 500
        range 125 1000
        help
            CAN bus bitrate in kbps.

    config DEMO_SLAVE_MAX_CHUNK_BYTES
        int "Max OTA chunk size"
        default 256
        range 64 1024
        help
            Maximum bytes per firmware data chunk.

    config DEMO_SLAVE_MAX_IMAGE_BYTES
        int "Max image size (bytes)"
        default 524288
        range 65536 2097152
        help
            Maximum allowed firmware image size in bytes.

endmenu
```
